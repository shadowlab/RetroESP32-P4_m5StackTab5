## components/odroid/Kconfig.projbuild
```kconfig
menu "RetroESP32 Platform"

    config BOARD_M5STACK_TAB5
        bool "Target the M5Stack Tab5 (5\" 720x1280 DSI tablet)"
        default n
        help
            Builds for the M5Stack Tab5 instead of the original RetroESP32-P4
            handheld: ILI9881C/ST7123 MIPI-DSI panel (auto-detected), GT911 or
            ST712x touch, ES8388 audio codec, IO-expander power rails and USB-A
            host for gamepads.  The GPIO gamepad is disabled (its pins are used by
            the audio codec).

    config TAB5_DOUBLE_BUFFER
        bool "Tab5: double-buffered, tear-free display"
        default y
        depends on BOARD_M5STACK_TAB5
        help
            Two 720x1280 frame buffers (+1.8 MB PSRAM) swapped at the panel's frame
            boundary, so a picture is never shown half-drawn.  Emulator frames that
            arrive before the previous one reached the screen are dropped rather than
            waited for, so emulation speed never depends on the panel refresh rate.

    config TAB5_ILI9881C_DPI_CLOCK_MHZ
        int "Tab5 v1 (ILI9881C) pixel clock (MHz)"
        default 60
        range 50 80
        depends on BOARD_M5STACK_TAB5
        help
            60 MHz is the M5Stack/esp-bsp setting and refreshes at ~48 Hz, below the
            emulators' 60 FPS.  75 MHz gives ~60 Hz but is outside the tested timing;
            try it if the v1 panel shows judder.

    config TAB5_ST712X_DPI_CLOCK_MHZ
        int "Tab5 v2/v3 (ST7123/ST7121) pixel clock (MHz)"
        default 70
        range 60 80
        depends on BOARD_M5STACK_TAB5
        help
            70 MHz is the esp-bsp setting (~58 Hz).  73 MHz gives ~60 Hz but is
            outside the tested timing.

endmenu
```

## components/tab5_ctrl/Kconfig
```kconfig
menu "Tab5 controller boards (RetroPad)"

    config TAB5_CTRL_ENABLE
        bool "Enable Tab5 keyboard-port controller boards"
        default n
        help
            Poll a controller board plugged into the M5Stack Tab5 keyboard
            port (Ext.Port1). Works with RetroPad console boards and with the
            stock M5Stack Tab5 Keyboard. Buttons are OR'd with the USB and GPIO
            gamepads. See hardware/tab5_controller/README.md.

    config TAB5_CTRL_I2C_SDA
        int "I2C SDA GPIO"
        default 0
        depends on TAB5_CTRL_ENABLE

    config TAB5_CTRL_I2C_SCL
        int "I2C SCL GPIO"
        default 1
        depends on TAB5_CTRL_ENABLE

    config TAB5_CTRL_I2C_ADDR
        hex "I2C address"
        default 0x6D
        depends on TAB5_CTRL_ENABLE

    config TAB5_CTRL_POLL_MS
        int "Poll period (ms)"
        default 4
        range 1 50
        depends on TAB5_CTRL_ENABLE

endmenu
```
